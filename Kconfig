## kas/Kconfig
```kconfig
config KAS_INCLUDE_COMMON
	string
	default "$(KAS_DIR)/common.yml"

source "kas/machine/Kconfig"

menu "Distro"

choice
	prompt "Select distribution"
	default ZARHUS_DISTRO

config ZARHUS_DISTRO
	bool "Distro for Zarhus product"

config ZARHUS_DISTRO_WEBKIT
	bool "Distro for Zarhus product with WebKit support"

endchoice

config KAS_INCLUDE_DISTRO
	string
	default "$(KAS_DIR)/webkit.yml" if ZARHUS_DISTRO_WEBKIT

endmenu

menu "Features"

config DEBUG
	bool "Debug features"
	help
		Add debug features such as passwordless root account, enable additional
		Linux kernel configs such as debugfs, add applications that might be
		helpful with debugging such as gdb or devmem

config KAS_INCLUDE_DEBUG
	string
	default "$(KAS_DIR)/debug.yml"
	depends on DEBUG

config CACHE
	bool "Enable use of cache"
	help
		Enable use of remote cache (configured in cache.yml)

config KAS_INCLUDE_CACHE
	string
	default "$(KAS_DIR)/cache.yml"
	depends on CACHE

endmenu
```

## kas/machine/Kconfig
```kconfig
menu "Machine"

choice
	prompt "Which machine/platform to build for"
	default RADXA_CM3

config ORANGEPI_CM4
	bool "Orange Pi CM4"

config QUARTZ64_A
	bool "Quartz64 Model A"

config RADXA_CM3
	bool "RadxaCM3"

config RPI4
	bool "Raspberry Pi 4"

endchoice

config KAS_INCLUDE_MACHINE
	string
	default "$(MACHINE_DIR)/orangepi-cm4.yml" if ORANGEPI_CM4
	default "$(MACHINE_DIR)/quartz64-a.yml" if QUARTZ64_A
	default "$(MACHINE_DIR)/radxa-cm3.yml" if RADXA_CM3
	default "$(MACHINE_DIR)/raspberrypi4.yml" if RPI4

config KAS_INCLUDE_BSP
	string
	default "$(KAS_DIR)/rockchip.yml" if ORANGEPI_CM4 || QUARTZ64_A || RADXA_CM3
	default "$(KAS_DIR)/rpi.yml" if RPI4

endmenu
```

## meta-zarhus-bsp/meta-zarhus-bsp-qemuarm/conf/machine/qemuarm-uboot.conf
```bitbake
require conf/machine/qemuarm.conf

# Use the same overrides as qemuarm machine.
MACHINEOVERRIDES:append = ":qemuarm"
WKS_FILE = "qemu.wks"
IMAGE_BOOT_FILES = "zImage"

# runqemu config
QB_DEFAULT_FSTYPE = "wic"
QB_FSINFO = "wic:no-kernel-in-fs"
QB_DEFAULT_BIOS = "${DEPLOY_DIR_IMAGE}/u-boot.bin"
QB_KERNEL_ROOT = "PARTLABEL=root"

do_image_wic[depends] += " \
    u-boot:do_deploy \
    "
```

## meta-zarhus-bsp/meta-zarhus-bsp-qemuarm/wic/qemu.wks
```
part v_storage --offset 7168s  --fixed-size 256K  --fstype=none --part-name v_storage
part reserved  --offset 7680s  --fixed-size 192K  --fstype=none --part-name reserved
part reserved1 --offset 8064s  --fixed-size 32K   --fstype=none --part-name reserved1
part uboot_env --offset 8128s  --fixed-size 32K   --fstype=none --part-name uboot_env
part reserved2 --offset 8192s  --fixed-size 4096K --fstype=none --part-name reserved2
part loader2   --offset 16384s --fixed-size 4096K --fstype=none --part-name loader2     --source rawcopy  --sourceparams="file=u-boot.bin"
part atf       --offset 24576s --fixed-size 4096K --fstype=none --part-name atf
part /boot     --label boot    --active           --fstype=vfat --part-name boot        --source rootfs   --rootfs-dir=${IMAGE_ROOTFS}/boot --use-uuid
part /         --label root                       --fstype=ext4 --part-name root        --source rootfs

bootloader --ptable gpt
```

## meta-zarhus-bsp/meta-zarhus-bsp-x86_64/conf/layer.conf
```bitbake
BBPATH .= ":${LAYERDIR}"
BBFILES += "${LAYERDIR}/recipes-*/*/*.bb \
            ${LAYERDIR}/recipes-*/*/*.bbappend"

BBFILE_COLLECTIONS += "zarhus-bsp-x86_64"
BBFILE_PATTERN_zarhus-bsp-x86_64 = "^${LAYERDIR}/"
BBFILE_PRIORITY_zarhus-bsp-rockchip = "5"

LAYERSERIES_COMPAT_zarhus-bsp-x86_64 = "scarthgap"
```

## meta-zarhus-bsp/meta-zarhus-bsp-x86_64/wic/zarhus-uki.wks
```
bootloader --timeout=0 --ptable gpt

part /boot --source bootimg-partition --fstype=vfat --label zarhus-boot --align 2048 --uuid ${BOOT_UUID} --active --use-uuid --part-type C12A7328-F81F-11D2-BA4B-00A0C93EC93B
part / --source rootfs --fstype=ext4 --label rootfs --align 2048 --uuid ${ROOT_UUID} --use-uuid --part-type C12A7328-F81F-11D2-BA4B-00A0C93EC93B
```

## meta-zarhus-distro/conf/distro/zarhus-distro-optee.conf
```bitbake
require conf/distro/include/zarhus-distro-common.conf

DISTRO = "zarhus-distro-optee"
DISTRO_NAME = "Distro for Zarhus product with OPTEE and ARM TrustZone support"
```

## meta-zarhus-distro/conf/distro/zarhus-distro.conf
```bitbake
require conf/distro/include/zarhus-distro-common.conf

DISTRO = "zarhus-distro"
DISTRO_NAME = "Distro for Zarhus product"
DISTRO_FEATURES += "splash"
# imagemagick resize format
LOGO_SIZE="480!x640!"
APPEND += "quiet splash"
```

## meta-zarhus-features/meta-otab/meta-otab-uki/conf/layer.conf
```bitbake
# We have a conf and classes directory, add to BBPATH
BBPATH .= ":${LAYERDIR}"

# We have recipes-* directories, add to BBFILES
BBFILES += "${LAYERDIR}/recipes-*/*/*.bb ${LAYERDIR}/recipes-*/*/*.bbappend"

BBFILE_COLLECTIONS += "otab-uki"
BBFILE_PATTERN_otab-uki = "^${LAYERDIR}/"
# One higher than meta-swupdate
BBFILE_PRIORITY_otab-uki = "7"

BBFILES_DYNAMIC += " \
    zarhus-bsp-x86_64:${LAYERDIR}/dynamic-layers/zarhus-bsp-x86_64/recipes-*/*/*.bbappend \
    zarhus:${LAYERDIR}/dynamic-layers/zarhus-distro/recipes-*/*/*.bb* \
    zarhus-encryption:${LAYERDIR}/dynamic-layers/zarhus-encryption/recipes-*/*/*.bb* \
"

# This should only be incremented on significant changes that will
# cause compatibility issues with other layers
LAYERVERSION_otab-uki = "1"

LAYERDEPENDS_otab-uki = " \
    otab-common \
    core \
    openembedded-layer \
    swupdate \
    readonly-rootfs-overlay \
    "

LAYERSERIES_COMPAT_otab-uki = "scarthgap master"

IMAGE_INSTALL:append = " fw-printenv"

##################################################
# OTAB variables
##################################################

WKS_FILE:x86-64 = "otab-uki-x86-uefi.wks.in"
OTAB_LABEL_BOOT_A ??= "boot_a"
OTAB_LABEL_BOOT_B ??= "boot_b"
OTAB_LABEL_ROOTFS_A ??= "rootfs_a"
OTAB_LABEL_ROOTFS_B ??= "rootfs_b"
OTAB_LABEL_ROOTFS_OVERLAY ??= "rwoverlay"
OTAB_LABEL_DATA ??= "data"

##################################################
# WKS rootfs-sed plugin variables
##################################################

# Generated with 'uuid -m' tool. Check
# dynamic-layers/zarhus-bsp-x86_64/recipes-zarhus/images/otab-uki.inc to see how
# to generate UUID based on repository commit
BOOT_A_UUID ??= "7d44af0e"
BOOT_B_UUID ??= "b32e6740"
ROOT_A_UUID ??= "b8a30442-412f-11f0-a7c2-d795d2926e45"
ROOT_B_UUID ??= "be43152c-412f-11f0-a99a-17f6567575ce"

# Temporary labels/uuid used during update
BOOT_TMP_UUID = "AAAA1111"
ROOT_TMP_UUID = "11111111-1111-1111-1111-111111111111"
BOOT_TMP_LABEL = "TMP_BOOT"
ROOT_TMP_LABEL = "TMP_ROOT"

WICVARS:append = " \
    BOOT_A_UUID ROOT_A_UUID \
"

UKI_CMDLINE:append = " \
    rootrw=/dev/disk/by-label/${OTAB_LABEL_ROOTFS_OVERLAY} \
    "

OTAB_BOOT_A_IMAGE_FSTYPE = ".direct.p1.gz"
OTAB_ROOTFS_A_IMAGE_FSTYPE ??= ".direct.p2.gz"
OTAB_DEVICE_BOOT_A ??= "${OTAB_DEVICE_MAIN}p1"
OTAB_DEVICE_BOOT_B ??= "${OTAB_DEVICE_MAIN}p3"
```
