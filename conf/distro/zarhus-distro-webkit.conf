## conf/distro/zarhus-distro-webkit.conf
```bitbake
require conf/distro/poky.conf

DISTRO = "zarhus-distro-webkit"

# distro name
DISTRO_NAME = "Distro for zarhus product with WebKit support"
DISTRO_VERSION = "0.1.0"
SDK_VENDOR = "-zarhussdk"

MAINTAINER = "3mdeb Sp. z o. o. <contact@3mdeb.com>"

TARGET_VENDOR = "-zarhus"

# distro features
# DISTRO_FEATURES_DEFAULT ?= "acl alsa argp bluetooth ext2 ipv4 ipv6 largefile pcmcia usbgadget usbhost wifi xattr nfs zeroconf pci 3g nfc x11 vfat"
# POKY_DEFAULT_DISTRO_FEATURES = "largefile opengl ptest multiarch wayland vulkan"
DISTRO_FEATURES = "${DISTRO_FEATURES_DEFAULT} systemd usrmerge"

# explictely use systemd and disable sysvinit completely
VIRTUAL-RUNTIME_init_manager = "systemd"
VIRTUAL-RUNTIME_initscripts = ""
VIRTUAL-RUNTIME_syslog = ""
DISTRO_FEATURES_BACKFILL_CONSIDERED += "sysvinit pulseaudio"

ROOT_PASSWORD = "OZuZFzdcWUJMls5k5u7ErPhRvMQTHh0V"
# According to https://docs.yoctoproject.org/singleindex.html#extrausers-bbclass
# mkpasswd should be used in order to set account password, this password for
# root was created with the meta-zarhus layer using the following command:
# `printf "%q" $(mkpasswd -m sha256crypt $ROOT_PASSWORD)`
# TODO: add way to automate generating ROOT_PASSWD, maybe split this before vs
# after honister update, because the method changed
ROOT_PASSWD = "TODO"


IMAGE_FSTYPES = "wic.gz wic.bmap"

require conf/distro/include/zarhus-webkit.conf
```

## conf/layer.conf
```bitbake
# We have a conf and classes directory, add to BBPATH
BBPATH .= ":${LAYERDIR}"

# We have recipes-* directories, add to BBFILES
BBFILES += "${LAYERDIR}/recipes-*/*/*.bb ${LAYERDIR}/recipes-*/*/*.bbappend"

BBFILE_COLLECTIONS += "zarhus"
BBFILE_PATTERN_zarhus = "^${LAYERDIR}/"
BBFILE_PRIORITY_zarhus = "1"

# This should only be incremented on significant changes that will
# cause compatibility issues with other layers
LAYERVERSION_zarhus = "1"

LAYERDEPENDS_zarhus = " \
    core \
    openembedded-layer \
    "

LAYERSERIES_COMPAT_zarhus = "scarthgap master"
```

## meta-zarhus-bsp-rockchip/conf/layer.conf
```bitbake
# We have a conf and classes directory, add to BBPATH
BBPATH .= ":${LAYERDIR}"

# We have recipes-* directories, add to BBFILES
BBFILES += "${LAYERDIR}/recipes-*/*/*.bb ${LAYERDIR}/recipes-*/*/*.bbappend"

BBFILE_COLLECTIONS += "zarhus-bsp-rockchip"
BBFILE_PATTERN_zarhus-bsp-rockchip = "^${LAYERDIR}/"
BBFILE_PRIORITY_zarhus-bsp-rockchip = "1"

# This should only be incremented on significant changes that will
# cause compatibility issues with other layers
LAYERVERSION_zarhus-bsp-rockchip = "1"

LAYERDEPENDS_zarhus-bsp-rockchip = " \
    core \
    openembedded-layer \
    rockchip \
    "

LAYERSERIES_COMPAT_zarhus-bsp-rockchip = "scarthgap master"

WKS_FILE = "sdimage-rockchip.wks"
```

## meta-zarhus-bsp/meta-zarhus-bsp-common/conf/layer.conf
```bitbake
# We have a conf and classes directory, add to BBPATH
BBPATH .= ":${LAYERDIR}"

# We have recipes-* directories, add to BBFILES
BBFILES += "${LAYERDIR}/recipes-*/*/*.bb ${LAYERDIR}/recipes-*/*/*.bbappend"

BBFILE_COLLECTIONS += "zarhus-bsp-common"
BBFILE_PATTERN_zarhus-bsp-common = "^${LAYERDIR}/"
BBFILE_PRIORITY_zarhus-bsp-common = "1"

# This should only be incremented on significant changes that will
# cause compatibility issues with other layers
LAYERVERSION_zarhus-bsp-common = "1"

LAYERDEPENDS_zarhus-bsp-common = " \
    core \
    "

LAYERSERIES_COMPAT_zarhus-bsp-common = "scarthgap master"

WKS_FILE = "sdimage-common.wks"
```

## meta-zarhus-bsp/meta-zarhus-bsp-common/conf/machine/include/firmware-ap6256.inc
```bitbake
# AP6256 is a WiFi / Bluetooth combo module
MACHINE_EXTRA_RDEPENDS += "armbian-firmware-bcm4345c5 armbian-firmware-bcm43456"
```

## meta-zarhus-bsp/meta-zarhus-bsp-rockchip/conf/machine/include/rk3566.inc
```bitbake
MACHINEOVERRIDES =. "rk3566:"

SOC_FAMILY = "rk3566"

DEFAULTTUNE ?= "cortexa55"

require conf/machine/include/soc-family.inc
require conf/machine/include/arm/armv8-2a/tune-cortexa55.inc
require conf/machine/include/rockchip-defaults.inc
require conf/machine/include/rockchip-wic.inc

KBUILD_DEFCONFIG ?= "defconfig"
KERNEL_FEATURES:append:rk3566 = " bsp/rockchip/remove-non-rockchip-arch-arm64.scc"
KERNEL_CLASSES = "kernel-fitimage"
KERNEL_IMAGETYPE ?= "fitImage"

PREFERRED_PROVIDER:trusted-firmware-a = "rockchip-rkbin"
PREFERRED_PROVIDER:optee-os = "rockchip-rkbin"

UBOOT_SUFFIX ?= "itb"
UBOOT_ENTRYPOINT ?= "0x06000000"
```

## meta-zarhus-bsp/meta-zarhus-bsp-rockchip/conf/machine/orangepi-cm4.conf
```bitbake
#@TYPE: Machine
#@NAME: OrangePi CM4
#@DESCRIPTION: OrangePi Compute Module CM4 Series is a System-on-Module based on
# the Rockchip RK3566, containing processor, memory, eMMC Flash and Power
# Management Unit.
# http://www.orangepi.org/html/hardWare/computerAndMicrocontrollers/service-and-support/Orange-Pi-CM4-1.html

require conf/machine/include/rk3566.inc

KERNEL_DEVICETREE = "rockchip/rk3566-orangepi-cm4-base.dtb"
MACHINE_EXTRA_RRECOMMENDS += "kernel-modules"
MACHINE_FEATURES += "alsa bluetooth serial usbhost wifi"
UBOOT_MACHINE = "orangepi-cm4-base-rk3566_defconfig"
```

## meta-zarhus-bsp/meta-zarhus-bsp-rockchip/conf/machine/quartz64-a.conf
```bitbake
#@TYPE: Machine
#@NAME: Quartz64 Model A
#@DESCRIPTION: The Quartz64 Model A is powered by a Rockchip RK3566 quad-core
# ARM Cortex A55 64-Bit Processor with a Mali G-52 GPU. It comes equipped with
# 2GB, 4GB or 8GB LPDDR4 system memory, and a 128Mb SPI boot flash.
# https://pine64.org/devices/quartz64_model_a/

require conf/machine/include/rk3566.inc

KERNEL_DEVICETREE = "rockchip/rk3566-quartz64-a.dtb"
MACHINE_EXTRA_RRECOMMENDS += "kernel-modules"

UBOOT_MACHINE = "quartz64-a-rk3566_defconfig"
```

## meta-zarhus-bsp/meta-zarhus-bsp-rockchip/conf/machine/radxa-cm3.conf
```bitbake
#@TYPE: Machine
#@NAME: Radxa Rock CM3
#@DESCRIPTION: Radxa Computing Module 3 Series (Radxa CM3 Series) is a series
#System-on-Module based on the Rockchip RK356x series, containing processor,
#memory, eMMC Flash and Power Management Unit. https://wiki.radxa.com/Rock3/CM3

require conf/machine/include/rk3566.inc

KERNEL_DEVICETREE = "rockchip/rk3566-radxa-cm3-io.dtb"
MACHINE_EXTRA_RRECOMMENDS += "kernel-modules"

UBOOT_MACHINE = "radxa-cm3-io-rk3566_defconfig"
```

## meta-zarhus-distro/conf/distro/zarhus-distro-webkit.conf
```bitbake
require conf/distro/include/zarhus-distro-common.conf

DISTRO = "zarhus-distro-webkit"
DISTRO_NAME = "Distro for Zarhus product with WebKit support"

require conf/distro/include/zarhus-webkit.conf
```

## meta-zarhus-webkit/conf/distro/include/zarhus-webkit.conf
```bitbake
# This configuration file adds WebKit-specific distro configuration.

DISTRO_FEATURES += " opengl wayland pam"
```

## meta-zarhus-webkit/conf/layer.conf
```bitbake
# We have a conf and classes directory, add to BBPATH
BBPATH .= ":${LAYERDIR}"

# We have recipes-* directories, add to BBFILES
BBFILES += "${LAYERDIR}/recipes-*/*/*.bb ${LAYERDIR}/recipes-*/*/*.bbappend"

BBFILE_COLLECTIONS += "zarhus-webkit"
BBFILE_PATTERN_zarhus-webkit = "^${LAYERDIR}/"
BBFILE_PRIORITY_zarhus-webkit = "1"

# This should only be incremented on significant changes that will
# cause compatibility issues with other layers
LAYERVERSION_zarhus-webkit = "1"

LAYERDEPENDS_zarhus-webkit = " \
    core \
    openembedded-layer \
    webkit \
    "

LAYERSERIES_COMPAT_zarhus-webkit = "scarthgap master"
```

## wic/sdimage-zarhus.wks
```
# short-description: Create system image with zarhus application
# long-description: Creates a partitioned system image for use with
# rock-3a. Boot files are located in the first vfat partition.

part /boot  --source bootimg-partition --ondisk mmcblk0 --fstype=vfat --label boot   --align 4096 --fixed-size 64  --active
part /      --source rootfs            --ondisk mmcblk0 --fstype=ext4 --label rootfs --align 4096 --fixed-size 512
```
